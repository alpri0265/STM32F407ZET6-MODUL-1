/**
 * @file ili9341.c
 * @brief Драйвер ILI9341 TFT 240x320, software SPI
 */
#include "ili9341.h"
#include "tft_config.h"
#include "stm32f4xx_hal.h"
#include <string.h>

/* ILI9341 команди */
#define ILI9341_NOP      0x00
#define ILI9341_SWRESET  0x01
#define ILI9341_SLPOUT   0x11
#define ILI9341_DISPON   0x29
#define ILI9341_CASET    0x2A
#define ILI9341_RASET    0x2B
#define ILI9341_RAMWR    0x2C
#define ILI9341_MADCTL   0x36
#define ILI9341_PIXFMT   0x3A
#define ILI9341_PWCTR1   0xC0
#define ILI9341_PWCTR2   0xC1
#define ILI9341_VMCTR1   0xC5
#define ILI9341_VMCTR2   0xC7
#define ILI9341_GMCTRP1  0xE0
#define ILI9341_GMCTRN1  0xE1

#define FONT_W  12   /* 5x7 * 2 */
#define FONT_H  14

/* 5x7 bitmap font, ASCII 0x20-0x7F (Adafruit glcdfont style) */
static const uint8_t font5x7[] = {
    0x00,0x00,0x00,0x00,0x00, 0x00,0x00,0x5F,0x00,0x00, 0x00,0x07,0x00,0x07,0x00,
    0x14,0x7F,0x14,0x7F,0x14, 0x24,0x2A,0x7F,0x2A,0x12, 0x23,0x13,0x08,0x64,0x62,
    0x36,0x49,0x56,0x20,0x50, 0x00,0x08,0x07,0x03,0x00, 0x00,0x1C,0x22,0x41,0x00,
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    0x00,0x41,0x36,0x08,0x00, 0x02,0x01,0x02,0x04,0x02
};
/* degree symbol 0x0E,0x11,0x11,0x0E,0x00 */
#define DEG_GLYPH {0x0E,0x11,0x11,0x0E,0x00}

static void spiwrite(uint8_t b)
{
    for (int i = 7; i >= 0; i--) {
        HAL_GPIO_WritePin(TFT_SCK_PORT, TFT_SCK_PIN, GPIO_PIN_RESET);
        HAL_GPIO_WritePin(TFT_MOSI_PORT, TFT_MOSI_PIN, (b & (1 << i)) ? GPIO_PIN_SET : GPIO_PIN_RESET);
        for (volatile int d = 0; d < 2; d++) (void)d;  /* невелика затримка для стабільності */
        HAL_GPIO_WritePin(TFT_SCK_PORT, TFT_SCK_PIN, GPIO_PIN_SET);
        for (volatile int d = 0; d < 2; d++) (void)d;
    }
}

static void write_cmd(uint8_t c)
{
    HAL_GPIO_WritePin(TFT_DC_PORT, TFT_DC_PIN, GPIO_PIN_RESET);
    HAL_GPIO_WritePin(TFT_CS_PORT, TFT_CS_PIN, GPIO_PIN_RESET);
    spiwrite(c);
    HAL_GPIO_WritePin(TFT_CS_PORT, TFT_CS_PIN, GPIO_PIN_SET);
}

static void write_data(uint8_t d)
{
    HAL_GPIO_WritePin(TFT_DC_PORT, TFT_DC_PIN, GPIO_PIN_SET);
    HAL_GPIO_WritePin(TFT_CS_PORT, TFT_CS_PIN, GPIO_PIN_RESET);
    spiwrite(d);
    HAL_GPIO_WritePin(TFT_CS_PORT, TFT_CS_PIN, GPIO_PIN_SET);
}

static void write_data16(uint16_t d)
{
    write_data(d >> 8);
    write_data(d & 0xFF);
}

static void set_addr_window(int16_t x0, int16_t y0, int16_t x1, int16_t y1)
{
    write_cmd(ILI9341_CASET);
    write_data(x0 >> 8);
    write_data(x0 & 0xFF);
    write_data(x1 >> 8);
    write_data(x1 & 0xFF);
    write_cmd(ILI9341_RASET);
    write_data(y0 >> 8);
    write_data(y0 & 0xFF);
    write_data(y1 >> 8);
    write_data(y1 & 0xFF);
    write_cmd(ILI9341_RAMWR);
}

void ili9341_init(void)
{
    __HAL_RCC_GPIOE_CLK_ENABLE();

    GPIO_InitTypeDef g = {0};
    g.Mode = GPIO_MODE_OUTPUT_PP;
    g.Pull = GPIO_NOPULL;
    g.Speed = GPIO_SPEED_FREQ_HIGH;

    g.Pin = TFT_SCK_PIN;
    HAL_GPIO_Init(TFT_SCK_PORT, &g);
    g.Pin = TFT_MOSI_PIN;
    HAL_GPIO_Init(TFT_MOSI_PORT, &g);
    g.Pin = TFT_CS_PIN;
    HAL_GPIO_Init(TFT_CS_PORT, &g);
    g.Pin = TFT_DC_PIN;
    HAL_GPIO_Init(TFT_DC_PORT, &g);
    g.Pin = TFT_RST_PIN;
    HAL_GPIO_Init(TFT_RST_PORT, &g);
    g.Pin = TFT_BL_PIN;
    HAL_GPIO_Init(TFT_BL_PORT, &g);

    HAL_GPIO_WritePin(TFT_CS_PORT, TFT_CS_PIN, GPIO_PIN_SET);
    HAL_GPIO_WritePin(TFT_BL_PORT, TFT_BL_PIN, GPIO_PIN_SET);  /* Підсвітка вкл */
    HAL_GPIO_WritePin(TFT_DC_PORT, TFT_DC_PIN, GPIO_PIN_SET);

    /* Reset: логіка RST — LOW = скид (lcdwiki) */
    HAL_GPIO_WritePin(TFT_RST_PORT, TFT_RST_PIN, GPIO_PIN_SET);
    HAL_Delay(50);
    HAL_GPIO_WritePin(TFT_RST_PORT, TFT_RST_PIN, GPIO_PIN_RESET);
    HAL_Delay(100);
    HAL_GPIO_WritePin(TFT_RST_PORT, TFT_RST_PIN, GPIO_PIN_SET);
    HAL_Delay(50);

    /* Ініціалізація 3.2" IPS ILI9341 (lcdwiki MSP3222/MSP3223) */
    write_cmd(0xCF);
    write_data(0x00); write_data(0xC1); write_data(0x30);
    write_cmd(0xED);
    write_data(0x64); write_data(0x03); write_data(0x12); write_data(0x81);
    write_cmd(0xE8);
    write_data(0x85); write_data(0x00); write_data(0x78);
    write_cmd(0xCB);
    write_data(0x39); write_data(0x2C); write_data(0x00); write_data(0x34); write_data(0x02);
    write_cmd(0xF7); write_data(0x20);
    write_cmd(0xEA);
    write_data(0x00); write_data(0x00);
    write_cmd(0xC0); write_data(0x13);
    write_cmd(0xC1); write_data(0x13);
    write_cmd(0xC5);
    write_data(0x1C); write_data(0x35);
    write_cmd(0xC7); write_data(0xC8);
    write_cmd(0x21);  /* Display Inversion On */
    write_cmd(0x36);  /* MADCTL: 90° (ландшафт 320x240), BGR */
    write_data(0x68);
    write_cmd(0xB6);
    write_data(0x0A); write_data(0xA2);
    write_cmd(0x3A); write_data(0x55);
    write_cmd(0xF6);
    write_data(0x01); write_data(0x30);
    write_cmd(0xB1);
    write_data(0x00); write_data(0x1B);
    write_cmd(0xF2); write_data(0x00);
    write_cmd(0x26); write_data(0x01);
    write_cmd(0xE0);
    write_data(0x0F); write_data(0x35); write_data(0x31); write_data(0x0B);
    write_data(0x0E); write_data(0x06); write_data(0x49); write_data(0xA7);
    write_data(0x33); write_data(0x07); write_data(0x0F); write_data(0x03);
    write_data(0x0C); write_data(0x0A); write_data(0x00);
    write_cmd(0xE1);
    write_data(0x00); write_data(0x0A); write_data(0x0F); write_data(0x04);
    write_data(0x11); write_data(0x08); write_data(0x36); write_data(0x58);
    write_data(0x4D); write_data(0x07); write_data(0x10); write_data(0x0C);
    write_data(0x32); write_data(0x34); write_data(0x0F);
    write_cmd(ILI9341_SLPOUT);
    HAL_Delay(120);
    write_cmd(ILI9341_DISPON);

    /* Діагностика: червоний екран + білий текст */
    ili9341_fill_screen(ILI9341_RED);
    ili9341_draw_string(20, 20, "TFT OK", ILI9341_WHITE, ILI9341_RED);
    HAL_Delay(500);
}

void ili9341_fill_screen(uint16_t color)
{
    ili9341_fill_rect(0, 0, TFT_WIDTH, TFT_HEIGHT, color);
}

void ili9341_fill_rect(int16_t x, int16_t y, uint16_t w, uint16_t h, uint16_t color)
{
    if (x < 0) { w += x; x = 0; }
    if (y < 0) { h += y; y = 0; }
    if (x + w > TFT_WIDTH)  w = TFT_WIDTH - x;
    if (y + h > TFT_HEIGHT) h = TFT_HEIGHT - y;
    if (w <= 0 || h <= 0) return;

    set_addr_window(x, y, x + w - 1, y + h - 1);
    HAL_GPIO_WritePin(TFT_DC_PORT, TFT_DC_PIN, GPIO_PIN_SET);
    HAL_GPIO_WritePin(TFT_CS_PORT, TFT_CS_PIN, GPIO_PIN_RESET);

    uint32_t n = (uint32_t)w * h;
    for (uint32_t i = 0; i < n; i++) {
        spiwrite(color >> 8);
        spiwrite(color & 0xFF);
    }
    HAL_GPIO_WritePin(TFT_CS_PORT, TFT_CS_PIN, GPIO_PIN_SET);
}

void ili9341_draw_pixel(int16_t x, int16_t y, uint16_t color)
{
    if (x < 0 || x >= TFT_WIDTH || y < 0 || y >= TFT_HEIGHT) return;
    set_addr_window(x, y, x, y);
    write_data16(color);
}

void ili9341_draw_char(int16_t x, int16_t y, char c, uint16_t fg, uint16_t bg)
{
    const uint8_t *glyph;
    const int scale = 2;  /* 5x7 -> 10x14 для читабельності на 3.2" */
    uint8_t gw = 5, gh = 7;

    if ((uint8_t)c == 0xFF) {
        static const uint8_t deg[] = {0x0E, 0x11, 0x11, 0x0E, 0x00};
        glyph = deg;
    } else if (c >= 0x20 && c <= 0x7E) {
        glyph = &font5x7[(c - 0x20) * 5];
    } else {
        glyph = &font5x7[0];
    }

    for (int col = 0; col < gw; col++) {
        uint8_t line = glyph[col];
        for (int row = 0; row < gh; row++) {
            uint16_t color = (line & (1 << row)) ? fg : bg;
            ili9341_fill_rect(x + col * scale, y + row * scale, scale, scale, color);
        }
    }
}

void ili9341_draw_string(int16_t x, int16_t y, const char *str, uint16_t fg, uint16_t bg)
{
    while (*str) {
        ili9341_draw_char(x, y, *str, fg, bg);
        x += FONT_W;
        str++;
    }
}
